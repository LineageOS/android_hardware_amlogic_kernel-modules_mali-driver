## mali/Kconfig
```kconfig
menu "Mali GPU OpenGL device driver"
config MALI400
	tristate "Mali-300/400/450 support"
	depends on ARM
	default m
	select DMA_SHARED_BUFFER
	---help---
	  This enables support for the ARM Mali-300, Mali-400, and Mali-450
	  GPUs.

	  To compile this driver as a module, choose M here: the module will be
	  called mali.

config MALI400_DEBUG
	bool "Enable debug in Mali driver"
	depends on MALI400
	---help---
	  This enabled extra debug checks and messages in the Mali driver.

config MALI400_OS_MEMORY_SIZE
	depends on MALI400
	int "OS Memory Size(MB)"
	range 64 2048
	default 480
	---help---
	  The size of mali OS memory with unit of mega byte.

config MALI400_PROFILING_EXTRA_SUPPORT
	bool "Select other items in kernel to support PROFILING."
	depends on MALI400_PROFILING
	select PROFILING
	select FTRACE
	select PERF_EVENTS
	select ENABLE_DEFAULT_TRACERS
	select DEBUG_MUTEXES
	select HIGH_RES_TIMERS
	select HW_PERF_EVENTS
	select CPU_FREQ

config MALI400_PROFILING
	bool "Enable Mali profiling"
	depends on MALI400
	select MALI400_DEBUG
	select TRACEPOINTS
	default n
	---help---
	  This enables gator profiling of Mali GPU events.

config MALI400_INTERNAL_PROFILING
	bool "Enable internal Mali profiling API"
	depends on MALI400_PROFILING
	default n
	---help---
	  This enables the internal legacy Mali profiling API.

config MALI400_UTILIZATION
	bool "Enable Mali Utilization and Frequency and pp scaling."
	depends on MALI400
	default y
	---help---
	  This enables the frequency and pp scaling.

config MALI400_UMP
	bool "Enable UMP support"
	depends on MALI400
	default n
	---help---
	  This enables support for the UMP memory sharing API in the Mali driver.

if ARCH_MESON6TV
config MALI400_4_PP
       bool "Mali 400 for M6TV With 4 pp core."
       depends on MALI400
       ---help---
         M6TV Lite only have 4 mali pp cores.
endif
	  
config MALI_DMA_BUF_MAP_ON_ATTACH
	bool "Map dma-buf attachments on attach"
	depends on MALI400 && DMA_SHARED_BUFFER
	default y
	---help---
	  This makes the Mali driver map dma-buf attachments after doing
	  attach. If this is not set the dma-buf attachments will be mapped for
	  every time the GPU need to access the buffer.

	  Mapping for each access can cause lower performance.

config MALI_SHARED_INTERRUPTS
	bool "Support for shared interrupts"
	depends on MALI400
	default y
	---help---
	  Adds functionality required to properly support shared interrupts.  Without this support,
	  the device driver will fail during insmod if it detects shared interrupts.  Works even if
	  the GPU is not using shared interrupts, but can cause lower performance.
endmenu
```
